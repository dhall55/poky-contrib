## conf/layer.conf
```bitbake
# Default to first disk/first partition on the Router Station Pro
RSP_ROOT ?= "sda1"
#RSP_ROOT ?= "sda2"

# We have a conf and classes directory, add to BBPATH
BBPATH := "${BBPATH}:${LAYERDIR}"

# We have an images and various recipe-* directories, add to BBFILES

BBFILES := "${BBFILES} ${LAYERDIR}/images/*.bb ${LAYERDIR}/images/*.bbappend ${LAYERDIR}/recipes-*/*/*.bb ${LAYERDIR}/recipes-*/*/*.bbappend"
	

BBFILE_COLLECTIONS += "demo"
BBFILE_PATTERN_demo := "^${LAYERDIR}/"
BBFILE_PRIORITY_demo = "6"
```

## meta-kernel-dev/conf/layer.conf
```bitbake
# Avoid having to split this into multiple layers
# Allow missing base recipe files for our bbappends
BB_DANGLINGAPPENDS_WARNONLY ?= "true"

# We have a conf and classes directory, add to BBPATH
BBPATH := "${BBPATH}:${LAYERDIR}"

# We have a packages directory, add to BBFILES
BBFILES := "${BBFILES} ${LAYERDIR}/recipes-*/*/*.bb \
            ${LAYERDIR}/recipes-*/*/*.bbappend"

BB_ENV_EXTRAWHITE := "KSRC"

require conf/include/revisions.inc
```

## meta-kernel-dev/conf/machine/example.conf
```bitbake
MACHINE_FEATURES = "kernel26 screen keyboard pci usbhost ext2 ext3 x86 \
                    acpi serial usbgadget"

KERNEL_IMAGETYPE = "bzImage"

PREFERRED_PROVIDER_virtual/kernel = "linux-yocto"

SERIAL_CONSOLE = "115200 ttyS0"

MACHINE_EXTRA_RRECOMMENDS = "kernel-modules eee-acpi-scripts"

IMAGE_ROOTFS_SIZE_ext3 = "2000000"

IMAGE_FSTYPES ?= "ext3 cpio.gz"
```

## meta-linaro/conf/layer.conf
```bitbake
# Default to first disk/first partition
RSP_ROOT ?= "sda1"

# We have a conf and classes directory, add to BBPATH
BBPATH := "${BBPATH}:${LAYERDIR}"

# We have an images and various recipe-* directories, add to BBFILES
BBFILES := "${BBFILES} ${LAYERDIR}/images/*.bb ${LAYERDIR}/images/*.bbappend ${LAYERDIR}/recipes-*/*.bb ${LAYERDIR}/recipes-*/*.bbappend"
	
BBFILE_COLLECTIONS += "linaro"
BBFILE_PATTERN_linaro := "^${LAYERDIR}/"
BBFILE_PRIORITY_linaro = "9"

# This layer builds images using a Linaro kernel. Override any machine
# specified kernel providers and leave it up to the kernel recipe to 
# determine COMPATIBLE_MACHINE.
PREFERRED_PROVIDER_virtual/kernel = "linux-linaro-2.6.35"

GCCVERSION = "4.5.1.linaro"
SDKGCCVERSION = "4.5.1.linaro"
```

## meta-m2m/conf/layer.conf
```bitbake
# We have a conf and classes directory, add to BBPATH
BBPATH := "${BBPATH}:${LAYERDIR}"

# We have a packages directory, add to BBFILES
BBFILES := "${BBFILES} ${LAYERDIR}/recipes-*/*/*.bb \
            ${LAYERDIR}/recipes-*/*/*.bbappend \
	    ${LAYERDIR}/images/*.bb \
	    ${LAYERDIR}/images/*.bbappend"

BBFILE_COLLECTIONS += "m2m"
BBFILE_PATTERN_m2m := "^${LAYERDIR}/"
BBFILE_PRIORITY_m2m = "6"
```

## meta-yocto/conf/distro/poky-tiny.conf
```bitbake
# NOTE: trying to inherit from poky, we may need to write this from scratch
# though...
require conf/distro/poky-common.inc

DISTRO = "poky-tiny"

# FIXME: consider adding a new "tiny" feature to trigger various changes to
# packages.
#DISTRO_FEATURES_append = " tiny"

# Distro config is evaluated after the machine config, so we have to explicitly
# set the kernel provider to override a machine config.
PREFERRED_PROVIDER_virtual/kernel = "linux-yocto-tiny"
PREFERRED_VERSION_linux-yocto-tiny = "3.0%"

# FIXME: this is probably fine, but we may need task-core-tiny instead...
#DISTRO_EXTRA_RDEPENDS += "task-core-boot"
#DISTRO_EXTRA_RRECOMMENDS += "kernel-module-af-packet"

# FIXME: what should we do with this?
TCLIBCAPPEND = ""

# Disable wide char support for ncurses as we don't include it in
# in the LIBC features below.
ENABLE_WIDEC="false"

# Reconfigure eglibc for a smaller installation
# Comment out any of the lines below to disable them in the build
DISTRO_FEATURES_LIBC_TINY = "libc-libm libc-crypt"
# Required for "who"
DISTRO_FEATURES_LIBC_MINIMAL = "libc-utmp libc-getlogin"
DISTRO_FEATURES_LIBC_REGEX = "libc-posix-regexp"
DISTRO_FEATURES_LIBC_NET = "libc-inet libc-nis"

DISTRO_FEATURES_LIBC = "${DISTRO_FEATURES_LIBC_TINY} \
                        ${DISTRO_FEATURES_LIBC_MINIMAL} \
                        ${DISTRO_FEATURES_LIBC_REGEX} \
                        ${DISTRO_FEATURES_LIBC_NET} \
                       "

# Comment out any of the lines below to disable them in the build
# FIXME: find the complete list for DISTRO_FEATURES
# DISTRO_FEATURES options: alsa bluetooth ext2 irda pcmcia usbgadget usbhost wifi nfs zeroconf pci
DISTRO_FEATURES_TINY = "pci"
DISTRO_FEATURES_NET = "ipv4 nfs"
DISTRO_FEATURES_USB = "usbhost"
#DISTRO_FEATURES_USBGADGET = "usbgadget"
#DISTRO_FEATURES_WIFI = "wifi"

DISTRO_FEATURES = "${DISTRO_FEATURES_TINY} \
                   ${DISTRO_FEATURES_NET} \
                   ${DISTRO_FEATURES_USB} \
                   ${DISTRO_FEATURES_USBGADGET} \
                   ${DISTRO_FEATURES_WIFI} \
                   ${DISTRO_FEATURES_LIBC} \
                  "

# Use tmpdevfs and the busybox runtime services
VIRTUAL-RUNTIME_dev_manager = ""
VIRTUAL-RUNTIME_login_manager = ""
VIRTUAL-RUNTIME_init_manager = ""

# FIXME: Consider adding "modules" to MACHINE_FEATURES and
# using that in task-core-base to select modutils-initscripts or not.
# Similar with "net" and netbase. Then use oe_filter_out to clear them here
# maybe.
# Drop "keyboard" as well to skip the keymaps.
```

## meta-yocto/conf/distro/poky.conf
```bitbake
require poky-common.inc

DISTRO = "poky"

DISTRO_FEATURES_append = " largefile opengl"

PREFERRED_VERSION_linux-yocto ?= "2.6.37+git%"
PREFERRED_VERSION_linux-yocto_qemux86 ?= "3.0%"
PREFERRED_VERSION_linux-yocto_qemux86-64 ?= "3.0%"
PREFERRED_VERSION_linux-yocto_qemuarm ?= "3.0%"
PREFERRED_VERSION_linux-yocto_qemumips ?= "3.0%"
PREFERRED_VERSION_linux-yocto_qemuppc ?= "3.0%"

DISTRO_EXTRA_RRECOMMENDS += "kernel-module-af-packet"
```

## meta/conf/distro/include/poky-xilinx-prebuilt.inc
```bitbake
#
# Config to use xilinx prebuilt toolchain
#

TARGET_VENDOR = "-unknown"

#PREFERRED_PROVIDER_linux-libc-headers = "xilinx-prebuilt-toolchain"
PREFERRED_PROVIDER_virtual/${TARGET_PREFIX}gcc = "xilinx-prebuilt-toolchian"
PREFERRED_PROVIDER_virtual/${TARGET_PREFIX}gcc-intermediate = "xilinx-prebuilt-toolchain"
PREFERRED_PROVIDER_virtual/${TARGET_PREFIX}gcc-initial = "xilinx-prebuilt-toolchain"
PREFERRED_PROVIDER_virtual/${TARGET_PREFIX}binutils = "xilinx-prebuilt-toolchain"
PREFERRED_PROVIDER_virtual/${TARGET_PREFIX}libc = "xilinx-prebuilt-toolchain"
#PREFERRED_PROVIDER_virtual/libc = "xilinx-prebuilt-toolchain"
#PREFERRED_PROVIDER_virtual/libintl = "xilinx-prebuilt-toolchain"
#PREFERRED_PROVIDER_virtual/libiconv = "xilinx-prebuilt-toolchain"
#PREFERRED_PROVIDER_virtual/linux-libc-headers = "xilinx-prebuilt-toolchain"
```

## meta/conf/machine/include/arch-arm.inc
```bitbake
TUNEVALID += "bigendian"
TUNE_ARCH = "${@bb.utils.contains("TUNE_FEATURES", "bigendian", "armeb", "arm" ,d)}"

ENDSUFX = "${@bb.utils.contains("TUNE_FEATURES", "bigendian", "b", "" ,d)}"

TUNEVALID += "fpu-hard"
TARGET_FPU = "${@bb.utils.contains("TUNE_FEATURES", "fpu-hard", "hard", "soft" ,d)}"
```

## meta/conf/machine/include/arch-ia32.inc
```bitbake
TUNEVALID += "m64"
TUNE_ARCH = "${@bb.utils.contains("TUNE_FEATURES", ["m64", "ml-lib64"], "x86_64", "i586" ,d)}"
TARGET_CC_ARCH +=  "${@bb.utils.contains("TUNE_FEATURES", ["m64", "ml-lib64"], "-m64", "-m32" ,d)}"

TUNEVALID += "ml-lib32"
TUNE_ARCH_ml-tune-lib32 = "i586"
base_libdir_ml-tune-lib32 = "/lib32"
libdir_ml-tune-lib32 = "/usr/lib32"
TUNEOVERRIDES .= "${@bb.utils.contains("TUNE_FEATURES", "ml-lib32", ":ml-tune-lib32", "", d)}"

TUNEVALID += "ml-lib64"
TUNE_ARCH_ml-tune-lib64 = "x86_64"
base_libdir_ml-tune-lib64 = "/lib64"
libdir_ml-tune-lib64 = "/usr/lib64"
TUNEOVERRIDES .= "${@bb.utils.contains("TUNE_FEATURES", "ml-lib64", ":ml-tune-lib64", "", d)}"

OVERRIDES .= "${TUNEOVERRIDES}"

GLIBC_ADDONS = "nptl"
GLIBC_EXTRA_OECONF = "--with-tls"
```
