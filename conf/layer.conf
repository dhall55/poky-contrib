## meta/conf/machine/include/arm/feature-arm-isa.inc
```bitbake
# The ARCH name is made up of:
#   arm<architecture><features><abi><endian>
# 
# ARM Architecture:
#   4 -- Oldest we support, StrongARM, ARM7TDMI...
#   5 -- 926ej-s, XScale and similar (compat w/ 4)
#   6 -- arm1136jf-s and similar (compat w/ 5)
#   7 -- Cortex-m1, Cortext-m3 (compat w/ 6)
#   7a -- Cortex-a8 (Compat w/ 7)
#   7r -- Cortex-r4
#
# ARM features:
#  (In display order)
#   t = thumb ISA [armv5 and below]
#   t2 = thumb2 addition [armv6 and above]
#   j = Jazelle extensions [not referenced in our tunings]
#   e = DSP extensions [armv5]
#
# ABI:
#  While non-standard, we also add in an ABI suffix of "hf" in order to
#  specify when the EABI VFP register calling convention is enabled.
#
# Endian:
#  a 'b' is tacked on if the architecture is running in big-endian.
#
# Examples:  armv5teb, armv4t, armv6t2, armv7at2

ARM_ARCH = "arm"
ARM_ARCH .= "${@bb.utils.contains("TUNE_FEATURES", "armv4", "v4", "", d)}"
ARM_ARCH .= "${@bb.utils.contains("TUNE_FEATURES", "armv5", "v5", "", d)}"
ARM_ARCH .= "${@bb.utils.contains("TUNE_FEATURES", "armv6", "v6", "", d)}"
ARM_ARCH .= "${@bb.utils.contains("TUNE_FEATURES", "armv7", "v7", "", d)}"
ARM_ARCH .= "${@bb.utils.contains("TUNE_FEATURES", "armv7a", "-a", "", d)}"

# ARM_THUMB is defined in the feature-arm-thumb

ARM_DSP    = "${@bb.utils.contains("TUNE_FEATURES", [ "armv5", "dsp" ], "e", "", d)}"

ARM_ENDIAN = "${@bb.utils.contains("TUNE_FEATURES", "bigendian", "b", "", d)}"

TARGET_CC_ARCH += "${@bb.utils.contains("TUNE_FEATURES", "arm", bb.utils.contains("TUNE_FEATURES", "armv7", "-march=${ARM_ARCH}", "-march=${ARM_ARCH}${ARM_THUMB}${ARM_DSP}", d), "", d)}"
TARGET_CC_ARCH += "${@bb.utils.contains("TUNE_FEATURES", "bigendian", "-mbig-endian", "", d)}"
```

## meta/conf/machine/include/arm/feature-arm-thumb.inc
```bitbake
#    The instruction set the compiler should use when generating application
#    code.  The kernel is always compiled with arm code at present.  arm code
#    is the original 32 bit ARM instruction set, thumb code is the 16 bit
#    encoded RISC sub-set.  Thumb code is smaller (maybe 70% of the ARM size)
#    but requires more instructions (140% for 70% smaller code) so may be
#    slower.

# Note armv7 will hit on armv7a as well
ARM_THUMB .= "${@bb.utils.contains("TUNE_FEATURES", [ "armv4", "thumb" ], "t", "", d)}"
ARM_THUMB .= "${@bb.utils.contains("TUNE_FEATURES", [ "armv5", "thumb" ], "t", "", d)}"
ARM_THUMB .= "${@bb.utils.contains("TUNE_FEATURES", [ "armv6", "thumb" ], "t2", "", d)}"
ARM_THUMB .= "${@bb.utils.contains("TUNE_FEATURES", [ "armv7", "thumb" ], "t2", "", d)}"

TARGET_CC_ARCH += "${@bb.utils.contains("TUNE_FEATURES", "thumb", "-mthumb", "-mno-thumb", d)}"
OVERRIDE       .= "${@bb.utils.contains("TUNE_FEATURES", "thumb", ":thumb", "", d)}"

#    Whether to compile with code to allow interworking between the two
#    instruction sets.  This allows thumb code to be executed on a primarily
#    arm system and vice versa.  It is strongly recommended that DISTROs not
#    turn this off - the actual cost is very small.
#
TARGET_CC_ARCH += "${@bb.utils.contains("TUNE_FEATURES", "no-thumb-interwork", "-mno-thumb-interwork", "-mthumb-interwork", d)}"
OVERRIDE       .= "${@bb.utils.contains("TUNE_FEATURES", "no-thumb-interwork", ":thumb-interwork", "", d)}"

TARGET_CC_KERNEL_ARCH  += "-mno-thumb-interwork -mno-thumb"
```

## meta/conf/machine/include/arm/tune-arm1136jf-s.inc
```bitbake
# Enable arm1136jf-s tunings
require conf/machine/include/arm/arch-arm.inc

TUNEVALID[arm1136jfs] = "Enable arm1136jfs specific processor optimizations"

AVAILTUNES += "arm1136jfs arm1136jfst"

TUNENAME = "arm1136jfs"

TUNE_FEATURES_tune-arm1136jfs = "${TUNE_FEATURES_tune-armv6} arm1136jfs"
TUNE_FEATURES_tune-arm1136jfst = "${TUNE_FEATURES_tune-armv6t} arm1136jfs"

TARGET_CC_ARCH	+= "${@bb.utils.contains("TUNE_FEATURES", "arm1136jfs", "-mtune=arm1136jf-s", "", d)}"

# Process has thumb2, so armv6t is compatible in all tunes
PACKAGE_EXTRA_ARCHS_tune-arm1136jfs  = "${PACKAGE_EXTRA_ARCHS_tune-armv6t}"
PACKAGE_EXTRA_ARCHS_tune-arm1136jfst = "${PACKAGE_EXTRA_ARCHS_tune-armv6t}"
```

## meta/conf/machine/include/arm/tune-arm920t.inc
```bitbake
# Enable 920t tunings
require conf/machine/include/arm/arch-arm.inc

TUNEVALID[arm920t] = "Enable arm920t specific processor optimizations"

AVAILTUNES += "arm920 arm920t"

TUNENAME = "arm920"

TUNE_FEATURES_tune-arm920 = "${TUNE_FEATURES_tune-armv4} arm920t"
TUNE_FEATURES_tune-arm920t = "${TUNE_FEATURES_tune-armv4t} arm920t"

TARGET_CC_ARCH	+= "${@bb.utils.contains("TUNE_FEATURES", "arm920t", "-mtune=arm920t", "", d)}"

# Process has thumb, so armv4t is compatible in all tunes
PACKAGE_EXTRA_ARCHS_tune-arm920  = "${PACKAGE_EXTRA_ARCHS_tune-armv4t}"
PACKAGE_EXTRA_ARCHS_tune-arm920t = "${PACKAGE_EXTRA_ARCHS_tune-armv4t}"
```

## meta/conf/machine/include/arm/tune-arm926ejs.inc
```bitbake
# Enable 920t tunings
require conf/machine/include/arm/arch-arm.inc

TUNEVALID[arm926ejs] = "Enable arm926ejs specific processor optimizations"

AVAILTUNES += "arm926ejs arm926ejst"

TUNENAME = "arm926ejs"

TUNE_FEATURES_tune-arm926ejs  = "${TUNE_FEATURES_tune-armv5e} arm926ejs"
TUNE_FEATURES_tune-arm926ejst = "${TUNE_FEATURES_tune-armv5te} arm926ejs"

TARGET_CC_ARCH	+= "${@bb.utils.contains("TUNE_FEATURES", "arm926ejs", "-mtune=arm926ej-s", "", d)}"

# Process has thumb, so armv4t is compatible in all tunes
PACKAGE_EXTRA_ARCHS_tune-arm926ejs  = "${PACKAGE_EXTRA_ARCHS_tune-armv5te}"
PACKAGE_EXTRA_ARCHS_tune-arm926ejst = "${PACKAGE_EXTRA_ARCHS_tune-armv5te}"
```

## meta/conf/machine/include/arm/tune-arm9tdmi.inc
```bitbake
# Enable arm9tdmi tunings
require conf/machine/include/arm/arch-arm.inc

TUNEVALID[arm9tdmi] = "Enable arm9tdmi specific processor optimizations"

AVAILTUNES += "arm9dmi arm9tdmi"

TUNENAME = "arm9dmi"

TUNE_FEATURES_tune-arm9dmi  = "${TUNE_FEATURES_tune-armv4} arm9tdmi"
TUNE_FEATURES_tune-arm9tdmi = "${TUNE_FEATURES_tune-armv4t} arm9tdmi"

TARGET_CC_ARCH	+= "${@bb.utils.contains("TUNE_FEATURES", "arm9tdmi", "-mtune=arm9tdmi", "", d)}"

# Process has thumb, so armv4t is compatible in all tunes
PACKAGE_EXTRA_ARCHS_tune-arm9dmi  = "${PACKAGE_EXTRA_ARCHS_tune-armv4t}"
PACKAGE_EXTRA_ARCHS_tune-arm9tdmi = "${PACKAGE_EXTRA_ARCHS_tune-armv4t}"
```

## meta/conf/machine/include/arm/tune-armv7.inc
```bitbake
# Enable armv7 tunings
require conf/machine/include/arm/arch-arm.inc

TUNENAME = "armv7"
```

## meta/conf/machine/include/arm/tune-cortexa8.inc
```bitbake
# Enable Cortex-A8 tunings
require conf/machine/include/arm/arch-arm.inc

TUNEVALID[cortexa8] = "Enable Cortex-A8 specific processor optimizations"

AVAILTUNES += "cortexa8 cortexa8t"

TUNENAME = "cortexa8"

TUNE_FEATURES_tune-cortexa8 = "${TUNE_FEATURES_tune-armv7a} coretexa8"
TUNE_FEATURES_tune-cortexa8t = "${TUNE_FEATURES_tune-armv7at} coretexa8"

TARGET_CC_ARCH	+= "${@bb.utils.contains("TUNE_FEATURES", "cortexa8", "-mtune=cortex-a8", "", d)}"

# Process has thumb, so armv7t is compatible in all tunes
PACKAGE_EXTRA_ARCHS_tune-cortexa8  = "${PACKAGE_EXTRA_ARCHS_tune-armv7at}"
PACKAGE_EXTRA_ARCHS_tune-cortexa8t = "${PACKAGE_EXTRA_ARCHS_tune-armv7at}"
```

## meta/conf/machine/include/arm/tune-cortexm1.inc
```bitbake
# Enable Cortex-M1 tunings
require conf/machine/include/arm/arch-arm.inc

TUNEVALID[cortexm1] = "Enable Cortex-M1 specific processor optimizations"

AVAILTUNES += "cortexm1 cortexm1t"

TUNENAME = "cortexm1"

TUNE_FEATURES_tune-cortexm1 = "${TUNE_FEATURES_tune-armv7} coretexm1"
TUNE_FEATURES_tune-cortexm1t = "${TUNE_FEATURES_tune-armv7t} coretexm1"

TARGET_CC_ARCH	+= "${@bb.utils.contains("TUNE_FEATURES", "cortexm1", "-mtune=cortex-m1", "", d)}"

# Process has thumb, so armv7t is compatible in all tunes
PACKAGE_EXTRA_ARCHS_tune-cortexm1  = "${PACKAGE_EXTRA_ARCHS_tune-armv7t}"
PACKAGE_EXTRA_ARCHS_tune-cortexm1t = "${PACKAGE_EXTRA_ARCHS_tune-armv7t}"
```

## meta/conf/machine/include/arm/tune-cortexr4.inc
```bitbake
# Enable Cortex-R4 tunings
require conf/machine/include/arm/arch-arm.inc

TUNEVALID[armv7r] = "Enable instructions for ARMv7-r"
TUNEVALID[cortexr4] = "Enable Cortex-R4 specific processor optimizations"

AVAILTUNES += "cortexr4 cortexr4t"

TUNENAME = "cortexr4"

# "armv7" will already have been caught, add midding r
ARCH_ARCH .= "${@bb.utils.contains("TUNE_FEATURES", "armv7r", "-r", "", d)}"

TUNE_FEATURES_tune-cortexr4 = "${TUNE_FEATURES_tune-armv7} armv7r coretexr4"
TUNE_FEATURES_tune-cortexr4t = "${TUNE_FEATURES_tune-armv7t} armv7r coretexr4"

TARGET_CC_ARCH	+= "${@bb.utils.contains("TUNE_FEATURES", "cortexr4", "-mtune=cortex-r4", "", d)}"

# Process has thumb, so armv7t is compatible in all tunes
PACKAGE_EXTRA_ARCHS_tune-cortexr4  = "${PACKAGE_EXTRA_ARCHS_tune-armv7t}"
PACKAGE_EXTRA_ARCHS_tune-cortexr4t = "${PACKAGE_EXTRA_ARCHS_tune-armv7t}"
```
