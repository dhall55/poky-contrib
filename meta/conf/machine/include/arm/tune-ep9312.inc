## meta/conf/machine/include/tune-atom.inc
```bitbake
DEFAULTTUNE ?= "atom"
TUNE_PKGARCH ?= "${@bb.utils.contains("TUNE_FEATURES", "m32", "atom", "atom-64", d)}"

require conf/machine/include/tune-i586.inc

# Extra tune features
TUNEVALID[atom] = "Enable atom-specific processor optimizations"
TUNE_CCARGS += "${@bb.utils.contains("TUNE_FEATURES", "atom", "-march=atom -mssse3 -mfpmath=sse", "", d)}"

# Extra tune selections
AVAILTUNES += "atom"
TUNE_FEATURES_tune-atom ?= "${TUNE_FEATURES_tune-x86} atom"
BASE_LIB_tune-atom ?= "lib"
PACKAGE_EXTRA_ARCHS_tune-atom = "${PACKAGE_EXTRA_ARCHS_tune-x86} i386 i486 i586 i686 atom"

AVAILTUNES += "atom-64"
TUNE_FEATURES_tune-atom-64 ?= "${TUNE_FEATURES_tune-x86-64} atom"
BASE_LIB_tune-atom-64 ?= "lib64"
PACKAGE_EXTRA_ARCHS_tune-atom-64 = "${PACKAGE_EXTRA_ARCHS_tune-x86-64} atom-64"

AVAILTUNES += "atom-64-x32"
TUNE_FEATURES_tune-atom-64-x32 ?= "${TUNE_FEATURES_tune-x86-64-x32} atom"
BASE_LIB_tune-atom-64-x32 ?= "libx32"
PACKAGE_EXTRA_ARCHS_tune-atom-64-x32 = "${PACKAGE_EXTRA_ARCHS_tune-x86-64-x32} atom-64-x32"
```

## meta/conf/machine/include/tune-corei7.inc
```bitbake
DEFAULTTUNE ?= "corei7"
TUNE_PKGARCH ?= "${@bb.utils.contains("TUNE_FEATURES", "avx", "corei7-avx", "corei7", d)}"

require conf/machine/include/tune-x86_64.inc

TUNEVALID[corei7] = "Enable corei7-specific processor optimizations"
TUNE_CCARGS += "${@bb.utils.contains("TUNE_FEATURES", "corei7", "-march=corei7${COREI7_AVX}", "", d)}"

COREI7_AVX = "${@bb.utils.contains("TUNE_FEATURES", [ "corei7", "avx" ], "-avx", "", d)}"

AVAILTUNES += "corei7"
TUNE_FEATURES_tune-corei7 = "${TUNE_FEATURES_tune-x86-64} corei7"
PACKAGE_EXTRA_ARCHS_tune-corei7 = "${PACKAGE_EXTRA_ARCHS_tune-x86-64} corei7"

AVAILTUNES += "corei7-avx"
TUNE_FEATURES_tune-corei7-avx = "${TUNE_FEATURES_tune-x86-64} corei7 avx"
PACKAGE_EXTRA_ARCHS_tune-corei7-avx = "${PACKAGE_EXTRA_ARCHS_tune-x86-64} corei7-avx"
```

## meta/conf/machine/include/tune-cortexa8.inc
```bitbake
require conf/machine/include/tune-armv7.inc

TUNENAME = "cortexa8"
TUNE_FEATURES_tune-cortexa8 ??= "hard-fpu neon"

TUNE_PKGARCH = "armv7a"

# Instead of using -mfpu=vfp[2] we can use -mfpu=neon to make use of gcc intrinsics[1] and vectorize loops with -ftree-vectorize[3]
# [1] http://gcc.gnu.org/onlinedocs/gcc/ARM-NEON-Intrinsics.html
# [2] http://gcc.gnu.org/onlinedocs/gcc/ARM-Options.html 
# [3] https://support.codesourcery.com/GNUToolchain/kbentry29
MAINOPTFLAGS ?= "-march=armv7-a -mtune=cortex-a8 -fno-tree-vectorize"

# Other potentially useful options
#-ftree-vectorize -ffast-math -fno-omit-frame-pointer

PACKAGE_EXTRA_ARCHS += "armv7a${ENDSUFX}${ARMSFX}"
```

## meta/conf/machine/include/tune-i586.inc
```bitbake
require conf/machine/include/arch-ia32.inc

TUNENAME = "i586"
TUNE_FEATURES_tune-i586 ??= ""

TUNE_PKGARCH = "i586"
TARGET_CC_ARCH = "-march=i586"
```

## meta/conf/machine/include/tune-ivb.inc
```bitbake
DEFAULTTUNE ?= "ivb"
TUNE_PKGARCH ?= "${@bb.utils.contains("TUNE_FEATURES", "ivb", "ivb", "", d)}"

require conf/machine/include/tune-x86_64.inc

TUNEVALID[ivb] = "Enable ivb-specific processor optimizations"
TUNE_CCARGS += "${@bb.utils.contains("TUNE_FEATURES", "ivb", "-march=core-avx-i", "", d)}"

AVAILTUNES += "ivb"
TUNE_FEATURES_tune-ivb = "${TUNE_FEATURES_tune-x86-64} ivb"
PACKAGE_EXTRA_ARCHS_tune-ivb = "${PACKAGE_EXTRA_ARCHS_tune-x86-64} ivb"
```

## meta/conf/machine/include/tune-ppc603e.inc
```bitbake
require conf/machine/include/arch-powerpc.inc

TUNENAME = "ppc603e"

TUNE_PKGARCH = "ppc603e"

TARGET_CC_ARCH = "-mcpu=603e  -mhard-float"

PACKAGE_EXTRA_ARCHS = "powerpc ppc603e"
```

## meta/conf/machine/include/tune-ppce300c2.inc
```bitbake
DEFAULTTUNE ?= "ppce300"

require conf/machine/include/powerpc/arch-powerpc.inc

TUNEVALID[ppce300] = "Enable ppce300 specific processor optimizations"
TUNE_CCARGS += "${@bb.utils.contains("TUNE_FEATURES", "ppce300", "-mcpu=e300c2", "", d)}"
TUNE_PKGARCH = "${@bb.utils.contains("TUNE_FEATURES", "ppce300", "ppce300", "${TUNE_ARCH}", d)}"

AVAILTUNES += "ppce300"
TUNE_FEATURES_tune-ppce300 = "m32 fpu-soft ppce300"
PACKAGE_EXTRA_ARCHS_tune-ppce300 = "powerpc ppce300"
```

## meta/conf/machine/include/tune-ppce500v2.inc
```bitbake
DEFAULTTUNE ?= "ppce500v2"

require conf/machine/include/powerpc/arch-powerpc.inc

TUNEVALID[ppce500mc] = "Enable ppce500mc specific processor optimizations"
TUNE_CCARGS += "${@bb.utils.contains("TUNE_FEATURES", "ppce500v2", "-mcpu=8548", "", d)}"
TUNE_PKGARCH .= "${@bb.utils.contains("TUNE_FEATURES", "ppce500v2", "ppce500v2", "", d)}"

AVAILTUNES += "ppce500v2"
TUNE_FEATURES_tune-ppce500v2 = "m32 spe ppce500v2"
PACKAGE_EXTRA_ARCHS_tune-ppce500v2 = "powerpc ppce500v2"
```
