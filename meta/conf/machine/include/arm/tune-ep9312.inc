## meta/conf/machine/include/arm/tune-ep9312.inc
```bitbake
# Enable EP9312 tunings
#   has an arm920t core plus a Mavrick math engine
require conf/machine/include/arm/tune-arm920t.inc

TUNEVALID[ep9312] = "Enable instructions for ep9312"

AVAILTUNES += "ep9312 ep9312t"

TUNENAME = "ep9312"

ARCH_ARCH .= "${@bb.utils.contains("TUNE_FEATURES", "ep9312", "ep9312", "", d)}"

TUNE_FEATURES_tune-ep9312 = "ep9312"
TUNE_FEATURES_tune-ep9312t = "ep9312 thumb"

TARGET_CC_ARCH	+= "${@bb.utils.contains("TUNE_FEATURES", "ep9312", "-mtune=ep9312 -mfp=maverick", "", d)}"

# Process has thumb, so armv4t is compatible in all tunes
PACKAGE_EXTRA_ARCHS_tune-ep9312  = "${PACKAGE_EXTRA_ARCHS_tune-arm920t} ep9312"
PACKAGE_EXTRA_ARCHS_tune-ep9312t = "${PACKAGE_EXTRA_ARCHS_tune-arm920t} ep9312"
```

## meta/conf/machine/include/arm/tune-iwmmxt.inc
```bitbake
# Enable IWMMXT tunings for PXA27x Applications Processor Family
# Use tune-xscale for PXA255/PXA26x based processors.
require conf/machine/include/arm/arch-arm.inc

TUNEVALID[iwmmxt] = "Enable instructions for iwmmxt"

AVAILTUNES += "iwmmx iwmmxt"

TUNENAME = "iwmmx"

ARCH_ARCH .= "${@bb.utils.contains("TUNE_FEATURES", "iwmmxt", "iwmmxt", "", d)}"

TUNE_FEATURES_tune-iwmmx = "iwmmxt"
TUNE_FEATURES_tune-iwmmxt = "iwmmxt thumb"

TARGET_CC_ARCH	+= "${@bb.utils.contains("TUNE_FEATURES", "iwmmxt", "-mtune=iwmmxt", "", d)}"

# Process has thumb, so armv5te is compatible in all tunes
PACKAGE_EXTRA_ARCHS_tune-iwmmx  = "${PACKAGE_EXTRA_ARCHS_tune-armv5te} iwmmx"
PACKAGE_EXTRA_ARCHS_tune-iwmmxt = "${PACKAGE_EXTRA_ARCHS_tune-armv5te} iwmmxt"
```

## meta/conf/machine/include/arm/tune-strongarm1100.inc
```bitbake
# Tuning for the StrongArm 1100
require conf/machine/include/arm/arch-arm.inc

TUNEVALID[strongarm1100] = "Enable instructions for StrongArm 1100"

AVAILTUNES += "strongarm1100"

TUNENAME = "strongarm1100"

TUNE_FEATURES_tune-strongarm1100 = "armv4 strongarm1100"

TARGET_CC_ARCH	+= "${@bb.utils.contains("TUNE_FEATURES", "strongarm1100", "-mtune=strongarm1100", "", d)}"

PACKAGE_EXTRA_ARCHS_tune-strongarm1100  = "${PACKAGE_EXTRA_ARCHS_tune-armv4}"
```

## meta/conf/machine/include/feature-arm-hardfp.inc
```bitbake
TUNEVALID += "callconvention-hard"
TARGET_CC_ARCH += "${@bb.utils.contains("TUNE_FEATURES", "callconvention-hard", "-mfloat-abi=hardfp", "-mfloat-abi=softfp" ,d)}"
ARMSFX .= "${@bb.utils.contains("TUNE_FEATURES", "callconvention-hard", "-hfp", "" ,d)}"
```

## meta/conf/machine/include/feature-arm-thumb.inc
```bitbake
#    The instruction set the compiler should use when generating application
#    code.  The kernel is always compiled with arm code at present.  arm code
#    is the original 32 bit ARM instruction set, thumb code is the 16 bit
#    encoded RISC sub-set.  Thumb code is smaller (maybe 70% of the ARM size)
#    but requires more instructions (140% for 70% smaller code) so may be
#    slower.
TUNEVALID += "thumb-instructions"
TARGET_CC_ARCH +=  "${@bb.utils.contains("TUNE_FEATURES", "thumb-instructions", "-mthumb", "-mno-thumb" ,d)}"
OVERRIDES .= "${@bb.utils.contains("TUNE_FEATURES", "thumb-instructions", ":thumb", "" ,d)}

#    Whether to compile with code to allow interworking between the two
#    instruction sets.  This allows thumb code to be executed on a primarily
#    arm system and vice versa.  It is strongly recommended that DISTROs not
#    turn this off - the actual cost is very small.
TUNEVALID += "thumb-interwork"
TARGET_CC_ARCH +=  "${@bb.utils.contains("TUNE_FEATURES", "thumb-interwork", "-mthumb-interwork", "-mno-thumb-interwork" ,d)}"
OVERRIDES .= "${@bb.utils.contains("TUNE_FEATURES", "thumb-interwork", ":thumb-interwork", "" ,d)}

TARGET_CC_KERNEL_ARCH  += "-mno-thumb-interwork -mno-thumb"
```

## meta/conf/machine/include/feature-arm-vfp.inc
```bitbake
TUNEVALID += "neon"
TARGET_FPU = "${@bb.utils.contains("TUNE_FEATURES", "neon", "-mfpu=neon", "-mfpu=vfp" ,d)}"
ARMSFX .= "${@bb.utils.contains("TUNE_FEATURES", "neon", "", "-vfponly" ,d)}"
```

## meta/conf/machine/include/ia32/arch-ia32.inc
```bitbake
#
# IA32 Architecture definition
#

DEFAULTTUNE ?= "x86"
TARGET_FPU ?= ""
X86ARCH32 ?= "i586"
X86ARCH64 ?= "x86_64"

# ELF32 ABI
TUNEVALID[x86-m32] = "IA32 ELF32 standard ABI"
TUNECONFLICTS[x86-m32] = "x86-64-m64 x86-64-mx32"
TUNE_ARCH .= "${@bb.utils.contains("TUNE_FEATURES", "x86-m32", "${X86ARCH32}", "" ,d)}"
TUNE_FEATURE_CCARGS-x86-m32 ?= "-m32"
TUNE_CCARGS += "${@bb.utils.contains("TUNE_FEATURES", "x86-m32", "${TUNE_FEATURE_CCARGS-x86-m32}", "", d)}"
MACHINEOVERRIDES .= "${@bb.utils.contains("TUNE_FEATURES", "x86-m32", ":x86", "" ,d)}"

# x32 ABI
TUNEVALID[x86-64-mx32] = "IA32e (x86_64) ELF32 standard ABI"
TUNECONFLICTS[x86-64-mx32] = "x86-64-m64 x86-m32"
TUNE_ARCH .= "${@bb.utils.contains("TUNE_FEATURES", "x86-64-mx32", "${X86ARCH64}", "" ,d)}"
ABIEXTENSION .= "${@bb.utils.contains("TUNE_FEATURES", "x86-64-mx32", "x32", "" ,d)}"
TUNE_FEATURE_CCARGS-x86-64-mx32 ?= "-mx32"
TUNE_CCARGS += "${@bb.utils.contains("TUNE_FEATURES", "x86-64-mx32", "${TUNE_FEATURE_CCARGS-x86-64-mx32}", "", d)}"
TUNE_LDARGS += "${@bb.utils.contains("TUNE_FEATURES", "x86-64-mx32", "-m elf32_x86_64", "", d)}"
TUNE_ASARGS += "${@bb.utils.contains("TUNE_FEATURES", "x86-64-mx32", "-x32", "", d)}"

# ELF64 ABI
TUNEVALID[x86-64-m64] = "IA32e (x86_64) ELF64 standard ABI"
TUNECONFLICT[x86-64-m64] = "x86-m32 x86-64-mx32"
TUNE_ARCH .= "${@bb.utils.contains("TUNE_FEATURES", "x86-64-m64", "${X86ARCH64}", "" ,d)}"
TUNE_FEATURE_CCARGS-x86-64-m64 ?= "-m64"
TUNE_CCARGS += "${@bb.utils.contains("TUNE_FEATURES", "x86-64-m64", "${TUNE_FEATURE_CCARGS-x86-64-m64}", "", d)}"

TUNE_PKGARCH ?= "${@bb.utils.contains("TUNE_FEATURES", "x86-m32", "x86", "x86_64", d)}"

# Default Tune configurations
AVAILTUNES += "x86"
TUNE_FEATURES_tune-x86 ?= "x86-m32"
BASE_LIB_tune-x86 ?= "lib"
PACKAGE_EXTRA_ARCHS_tune-x86 = "x86"

AVAILTUNES += "x86-64"
TUNE_FEATURES_tune-x86-64 ?= "x86-64-m64"
BASE_LIB_tune-x86-64 ?= "lib64"
PACKAGE_EXTRA_ARCHS_tune-x86-64 = "x86_64"

AVAILTUNES += "x86-64-x32"
TUNE_FEATURES_tune-x86-64-x32 ?= "x86-64-mx32"
BASE_LIB_tune-x86-64-x32 ?= "libx32"
PACKAGE_EXTRA_ARCHS_tune-x86-64-x32 = "x86_64_x32"
TUNE_PKGARCH .= "${@bb.utils.contains("TUNE_FEATURES", "x86-64-mx32", "_x32", "", d)}"
```

## meta/conf/machine/include/ia32/tune-atom.inc
```bitbake
# Atom tunings are the same as core2 for now...
require conf/machine/include/ia32/tune-core2.inc
```

## meta/conf/machine/include/ia32/tune-core2.inc
```bitbake
# Enable core2 tunings, and compatibility with i586
require conf/machine/include/ia32/tune-i586.inc

TUNEVALID[core2] = "Enable core2 specific processor optimizations"

AVAILTUNES += "core2 core2-64"

TUNENAME = "core2"

TUNE_FEATURES_tune-core2    ?= "${TUNE_FEATURES_tune-x86} core2"
TUNE_FEATURES_tune-core2-64 ?= "${TUNE_FEATURES_tune-x86-64} core2"

TARGET_CC_ARCH	+= "${@bb.utils.contains("TUNE_FEATURES", "core2", "-march=core2 -msse3 -mtune=generic -mfpmath=sse", "", d)}"

TUNE_ARCH	 = "${@bb.utils.contains("TUNE_FEATURES", "m32", "i686", "x86_64", d)}"
TUNE_PKGARCH	 = "${@bb.utils.contains("TUNE_FEATURES", "m32", "core2", "core2-64", d)}"

BASE_LIB_tune-core2    = "lib"
BASE_LIB_tune-core2-64 = "lib64"

PACKAGE_EXTRA_ARCHS_tune-core2 = "${PACKAGE_EXTRA_ARCHS_tune-x86} i386 i486 i586 i686 core2"
PACKAGE_EXTRA_ARCHS_tune-core2-64 = "${PACKAGE_EXTRA_ARCHS_tune-x86-64} core2-64"
```

## meta/conf/machine/include/ia32/tune-i586.inc
```bitbake
# Enable i586 tunings
require conf/machine/include/ia32/arch-ia32.inc

TUNEVALID[i586] = "Enable i586 specific processor optimizations"

AVAILTUNES += "i586"

TUNENAME = "i586"

TUNE_FEATURES_tune-i586    ?= "${TUNE_FEATURES_tune-x86} i586"

TARGET_CC_ARCH	+= "${@bb.utils.contains("TUNE_FEATURES", "i586", "-march=i586", "", d)}"

TUNE_ARCH	 = "i586"
TUNE_PKGARCH	 = "i586"

BASE_LIB_tune-i586    = "lib"

PACKAGE_EXTRA_ARCHS_tune-i586 = "${TUNE_FEATURES_tune-x86} i386 i486 i586"
```

## meta/conf/machine/include/ia32/tune-x86_64.inc
```bitbake
# Use the default tunings, but change the tune to x86-64.
require conf/machine/include/ia32/arch-ia32.inc

TUNENAME = "x86-64"
```

## meta/conf/machine/include/mips/arch-mips.inc
```bitbake
# MIPS Architecture definition
# 12 defined ABIs, all combinations of:
# *) Big/Little Endian
# *) Hardware/Software Floating Point
# *) o32, n32, n64 ABI

DEFAULTTUNE ?= "mips"

# Endianess
TUNEVALID[mips-bigendian] = "Enable big-endian mode"
TUNE_CCARGS += "${@bb.utils.contains("TUNE_FEATURES", "mips-bigendian", "-meb", "-mel", d)}"

# ABI flags
TUNEVALID[mips-o32] = "MIPS o32 ABI"
TUNECONFLICT[mips-o32] = "mips-n32 mips-n64"
TUNE_FEATURE_CCARGS-mips-o32 ?= "-mabi=32"
TUNE_CCARGS += "${@bb.utils.contains("TUNE_FEATURES", "mips-o32", "${TUNE_FEATURE_CCARGS-mips-o32}", "", d)}"

TUNEVALID[mips-n32] = "MIPS64 n32 ABI"
TUNECONFLICT[mips-n32] = "mips-o32 mips-n64"
TUNE_FEATURE_CCARGS-mips-n32 ?= "-mabi=n32"
TUNE_CCARGS += "${@bb.utils.contains("TUNE_FEATURES", "mips-n32", "${TUNE_FEATURE_CCARGS-mips-n32}", "", d)}"

TUNEVALID[mips-n64] = "MIPS64 n64 ABI"
TUNECONFLICT[mips-n64] = "mips-o32 mips-n32"
TUNE_FEATURE_CCARGS-mips-n64 ?= "-mabi=64"
TUNE_CCARGS += "${@bb.utils.contains("TUNE_FEATURES", "mips-n64", "${TUNE_FEATURE_CCARGS-mips-n64}", "", d)}"

# Floating point
TUNEVALID[mips-fpu-hard] = "Use hardware FPU"
TUNE_CCARGS += "${@bb.utils.contains("TUNE_FEATURES", "mips-fpu-hard", "-mhard-float", "-msoft-float", d)}"
TARGET_FPU = "${@bb.utils.contains("TUNE_FEATURES", "mips-fpu-hard", "", "soft", d)}"

# Package naming
MIPSPKGSFX_ENDIAN = "${@bb.utils.contains("TUNE_FEATURES", "mips-bigendian", "", "el", d)}"
MIPSPKGSFX_BYTE = "${@bb.utils.contains("TUNE_FEATURES", "mips-n64" , "64", "", d)}"
MIPSPKGSFX_BYTE .= "${@bb.utils.contains("TUNE_FEATURES", "mips-n32" , "64", "", d)}"
MIPSPKGSFX_FPU = "${@bb.utils.contains("TUNE_FEATURES", "mips-fpu-hard" , "", "-nf", d)}"
MIPSPKGSFX_ABI = "${@bb.utils.contains("TUNE_FEATURES", "mips-n32", "-n32", "", d)}"

TUNE_ARCH = "mips${MIPSPKGSFX_BYTE}${MIPSPKGSFX_ENDIAN}"
TUNE_PKGARCH ?= "${TUNE_ARCH}${MIPSPKGSFX_FPU}${MIPSPKGSFX_ABI}"

# Base tunes
AVAILTUNES += "mips mips64-n32 mips64 mipsel mips64el-n32 mips64el mips-nf mips64-nf-n32 mips64-nf mipsel-nf mips64el-nf-n32 mips64el-nf"
TUNE_FEATURES_tune-mips = "mips-o32 mips-bigendian mips-fpu-hard"
BASE_LIB_tune-mips = "lib"
TUNE_FEATURES_tune-mips64-n32 = "mips-n32 mips-bigendian mips-fpu-hard"
BASE_LIB_tune-mips64-n32 = "lib32"
TUNE_FEATURES_tune-mips64 = "mips-n64 mips-bigendian mips-fpu-hard"
BASE_LIB_tune-mips64 = "lib64"
TUNE_FEATURES_tune-mipsel = "mips-o32 mips-fpu-hard"
BASE_LIB_tune-mipsel = "lib"
TUNE_FEATURES_tune-mips64el-n32 = "mips-n32 mips-fpu-hard"
BASE_LIB_tune-mips64el-n32 = "lib32"
TUNE_FEATURES_tune-mips64el = "mips-n64 mips-fpu-hard"
BASE_LIB_tune-mips64el = "lib64"
TUNE_FEATURES_tune-mips-nf = "mips-o32 mips-bigendian"
BASE_LIB_tune-mips-nf = "lib"
TUNE_FEATURES_tune-mips64-nf-n32 = "mips-n32 mips-bigendian"
BASE_LIB_tune-mips64-nf-n32 = "lib32"
TUNE_FEATURES_tune-mips64-nf = "mips-n64 mips-bigendian"
BASE_LIB_tune-mips64-nf = "lib64"
TUNE_FEATURES_tune-mipsel-nf = "mips-o32"
BASE_LIB_tune-mipsel-nf = "lib"
TUNE_FEATURES_tune-mips64el-nf-n32 = "mips-n32"
BASE_LIB_tune-mips64el-nf-n32 = "lib32"
TUNE_FEATURES_tune-mips64el-nf = "mips-n64"
BASE_LIB_tune-mips64el-nf = "lib64"
```

## meta/conf/machine/include/power/arch-power.inc
```bitbake
# Power Architecture definition
# Four defined ABIs, all combinations of:
# *) Hard/Soft Floating Point
# *) 32-bit/64-bit

TUNEVALID[fpu-hard] = "Use hardware FPU."
TUNEVALID[m32] = "Power ELF32 standard ABI"
TUNEVALID[m64] = "Power ELF64 standard ABI"

# Define tunes
AVAILTUNES += "powerpc powerpc64 powerpc-nf powerpc64-nf"

TUNE_FEATURES_tune-powerpc	?= "m32 fpu-hard"
TUNE_FEATURES_tune-powerpc64	?= "m64 fpu-hard"
TUNE_FEATURES_tune-powerpc-nf	?= "m32"
TUNE_FEATURES_tune-powerpc64-nf	?= "m64"

# Select a reasonable default
TUNENAME ?= "powerpc"

# Define canonical arch
TUNE_ARCH	 = "${@bb.utils.contains("TUNE_FEATURES", [ "m64" ], "powerpc64", "powerpc", d)}"

# ABI
TARGET_CC_ARCH	+= "${@bb.utils.contains("TUNE_FEATURES", "m32", "-m32", "", d)}"
TARGET_CC_ARCH	+= "${@bb.utils.contains("TUNE_FEATURES", "n64", "-m64", "", d)}"

# Floating Point
TARGET_CC_ARCH	+= "${@bb.utils.contains("TUNE_FEATURES", "fpu-hard", "-mhard-float", "-msoft-float", d)}"
TARGET_FPU	 = "${@bb.utils.contains("TUNE_FEATURES", "fpu-hard", "hard", "soft", d)}"

# Base library directory
BASE_LIB_tune-powerpc	   = "lib"
BASE_LIB_tune-powerpc64	   = "lib64"
BASE_LIB_tune-powerpc-nf   = "lib"
BASE_LIB_tune-powerpc64-nf = "lib64"
```

## meta/conf/machine/include/powerpc/arch-powerpc.inc
```bitbake
# Power Architecture definition
# Four defined ABIs, all combinations of:
# *) Hard/Soft Floating Point
# *) 32-bit/64-bit

DEFAULTTUNE ?= "powerpc"

TUNEVALID[ppc-m32] = "Power ELF32 standard ABI"
TUNE_FEATURE_CCARGS-ppc-m32 ?= "-m32"
TUNE_CCARGS += "${@bb.utils.contains("TUNE_FEATURES", "ppc-m32", "${TUNE_FEATURE_CCARGS-ppc-m32}", "", d)}"
TUNE_ARCH .= "${@bb.utils.contains("TUNE_FEATURES", "ppc-m32", "powerpc", "", d)}"

TUNEVALID[ppc-fpu-hard] = "Use hardware FPU."
TUNE_CCARGS += "${@bb.utils.contains("TUNE_FEATURES", "ppc-fpu-hard", "-mhard-float", "", d)}"

TUNEVALID[ppc-fpu-soft] = "Use software FPU."
TUNE_FEATURE_CCARGS-ppc-fpu-soft ?= "-msoft-float"
TUNE_CCARGS += "${@bb.utils.contains("TUNE_FEATURES", "ppc-fpu-soft", "${TUNE_FEATURE_CCARGS-ppc-fpu-soft}", "", d)}"
TARGET_FPU .= "${@bb.utils.contains("TUNE_FEATURES", "ppc-fpu-soft", "soft", "", d)}"

ABIEXTENSION = "${@['','spe'][d.getVar('TARGET_FPU', True) in ['ppc-efd', 'ppc-efs']]}"

PPCPKGSFX_FPU = "${@bb.utils.contains("TUNE_FEATURES", "ppc-fpu-hard" , "", "-nf", d)}"

PPCPKGARCH = "${TUNE_ARCH}${PPCPKGSFX_FPU}"
TUNE_PKGARCH ?= "${PPCPKGARCH}"

# Basic tune definitions
AVAILTUNES += "powerpc powerpc-nf" 
TUNE_FEATURES_tune-powerpc-nf ?= "ppc-m32 ppc-fpu-soft"
BASE_LIB_tune-powerpc-nf = "lib"
PACKAGE_EXTRA_ARCHS_tune-powerpc-nf = "powerpc-nf"
TUNE_FEATURES_tune-powerpc ?= "ppc-m32 ppc-fpu-hard"
BASE_LIB_tune-powerpc = "lib"
PACKAGE_EXTRA_ARCHS_tune-powerpc = "${PACKAGE_EXTRA_ARCHS_tune-powerpc-nf} powerpc"
```

## meta/conf/machine/include/powerpc/arch-powerpc64.inc
```bitbake
DEFAULTTUNE ?= "powerpc64"

require conf/machine/include/powerpc/arch-powerpc.inc

TUNEVALID[ppc-m64] = "Power ELF64 standard ABI"
TUNE_CONFLICTS[ppc-m64] = "ppc-m32 ppc-nf"
TUNE_FEATURE_CCARGS-ppc-m64 ?= "-m64"
TUNE_CCARGS += "${@bb.utils.contains("TUNE_FEATURES", "ppc-m64", "${TUNE_FEATURE_CCARGS-ppc-m64}", "", d)}"
TUNE_ARCH .= "${@bb.utils.contains("TUNE_FEATURES", [ "ppc-m64" ], "powerpc64", "", d)}"

AVAILTUNES += "powerpc64"
TUNE_FEATURES_tune-powerpc64 ?= "ppc-m64 ppc-fpu-hard"
BASE_LIB_tune-powerpc64 = "lib64"
```

## meta/conf/machine/include/tune-armv7.inc
```bitbake
require conf/machine/include/arch-arm.inc
require conf/machine/include/feature-arm-thumb.inc
require conf/machine/include/feature-arm-hardfp.inc
require conf/machine/include/feature-arm-vfp.inc

TUNENAME = "armv7"
TUNE_FEATURES_tune-armv7 ??= "fpu-hard"

TUNE_PKGARCH = "armv7${ARMSFX}"

# valid options for -march: `armv7', `armv7-a', `armv7-r', `armv7-m'
# valid option for -mtune: `cortex-a8', `cortex-r4', `cortex-m3', `cortex-m1'
# This will NOT compile programs in 'ARM' mode, which is what you really want
MAINOPTFLAGS ?= "-march=armv7"

TARGET_CC_ARCH += "${MAINOPTFLAGS}"
PACKAGE_EXTRA_ARCHS = "${TUNE_ARCH}${ARMSFX} armv4${ENDSUFX}${ARMSFX} armv4t${ENDSUFX}${ARMSFX} armv5te${ENDSUFX}${ARMSFX} armv6${ENDSUFX}${ARMSFX} armv7${ENDSUFX}${ARMSFX}"
```
