## meta/conf/machine/include/tune-x86_64.inc
```bitbake
require conf/machine/include/arch-ia32.inc

TUNENAME = "x86_64"
TUNE_FEATURES_tune-x86_64 ??= "m64"

TUNE_PKGARCH = "x86_64"
```

## meta/conf/machine/qemuarm.conf
```bitbake
#@TYPE: Machine
#@NAME: arm_versaile_926ejs
#@DESCRIPTION: arm_versaile_926ejs

require conf/machine/include/qemu.inc
#require conf/machine/include/arm/tune-arm926ejs.inc
#require conf/machine/include/arm/tune-arm920t.inc
require conf/machine/include/arm/tune-arm1136jf-s.inc

KERNEL_IMAGETYPE = "zImage"

SERIAL_CONSOLE = "115200 ttyAMA0"
```

## scripts/lib/bsp/substrate/target/arch/i386/conf/machine/{{=machine}}.conf
```bitbake
#@TYPE: Machine
#@NAME: {{=machine}}

#@DESCRIPTION: Machine configuration for {{=machine}} systems

PREFERRED_PROVIDER_virtual/kernel ?= "linux-yocto"

{{ input type:"choicelist" name:"tunefile" msg:"Which machine tuning would you like to use?" }}
{{ input type:"choice" val:"tune_atom" msg:"Atom tuning optimizations" }}
{{ input type:"choice" val:"tune_core2" msg:"Core2 tuning optimizations" }}
{{ if tunefile == "tune_atom": }}
include conf/machine/include/tune-atom.inc
{{ if tunefile == "tune_core2": }}
include conf/machine/include/tune-core2.inc

require conf/machine/include/ia32-base.inc

{{ input type:"boolean" name:"xserver" msg:"Do you need support for X?" }}
{{ input type:"choicelist" name:"xserver_choice" msg:"Please select an xserver for this machine" depends-on:"xserver" depends-on-val:"yes"}}
{{ input type:"choice" val:"xserver_vesa" msg:"VESA xserver support" }}
{{ input type:"choice" val:"xserver_emgd" msg:"EMGD xserver support (proprietary)" }}
{{ input type:"choice" val:"xserver_i915" msg:"i915 xserver support" }}
{{ if xserver == "yes": }}
XSERVER ?= "${XSERVER_IA32_BASE} \
           ${XSERVER_IA32_EXT} \
{{ if xserver_choice == "xserver_vesa": }}
           ${XSERVER_IA32_VESA} \
{{ if xserver_choice == "xserver_emgd": }}
           ${XSERVER_IA32_EMGD} \
{{ if xserver_choice == "xserver_i915": }}
           ${XSERVER_IA32_I915} \
{{ if xserver == "yes": }}
           "

{{ if xserver_choice == "xserver_emgd": }}
PREFERRED_VERSION_xserver-xorg ?= "1.9.3"
PREFERRED_VERSION_mesa-dri ?= "7.11"
PREFERRED_VERSION_emgd-driver-bin ?= "1.8"

{{ if xserver_choice == "xserver_vesa" or xserver_choice == "xserver_emgd": }}
APPEND += "video=vesafb vga=0x318"
```

## scripts/lib/bsp/substrate/target/arch/qemu/conf/machine/{{=machine}}.conf
```bitbake
#@TYPE: Machine
#@NAME: {{=machine}}

#@DESCRIPTION: Machine configuration for {{=machine}} systems

PREFERRED_PROVIDER_virtual/xserver ?= "xserver-xorg"

PREFERRED_PROVIDER_virtual/kernel ?= "linux-yocto"
PREFERRED_VERSION_linux-yocto ?= "3.0%"

{{ input type:"choicelist" name:"qemuarch" prio:"1" msg:"Which qemu architecture would you like to use?" }}
{{ input type:"choice" val:"x86" msg:"common 32-bit x86" }}
{{ input type:"choice" val:"x86_64" msg:"common 64-bit x86" }}
{{ input type:"choice" val:"arm" msg:"common 32-bit ARM" }}
{{ input type:"choice" val:"powerpc" msg:"common 32-bit PowerPC" }}
{{ input type:"choice" val:"mips" msg:"common 32-bit MIPS" }}
{{ if qemuarch == "x86": }}
require conf/machine/include/tune-i586.inc
{{ if qemuarch == "x86_64": }}
require conf/machine/include/tune-i586.inc
{{ if qemuarch == "arm": }}
require conf/machine/include/tune-arm926ejs.inc
{{ if qemuarch == "powerpc": }}
require conf/machine/include/tune-ppc603e.inc
{{ if qemuarch == "mips": }}
require conf/machine/include/tune-mips32.inc

require conf/machine/include/qemu.inc

{{ if qemuarch == "x86" or qemuarch == "x86_64": }}
MACHINE_FEATURES += "x86"
KERNEL_IMAGETYPE = "bzImage"
SERIAL_CONSOLE = "115200 ttyS0"
# We bypass swrast but we need it to be present for X to load correctly
XSERVER ?= "xserver-xorg \
           mesa-dri-driver-swrast \
           xf86-input-vmmouse \
           xf86-input-keyboard \
           xf86-input-evdev \
           xf86-video-vmware \
           qemugl"
GLIBC_ADDONS = "nptl"
GLIBC_EXTRA_OECONF = "--with-tls"

{{ if qemuarch == "arm": }}
KERNEL_IMAGETYPE = "zImage"
SERIAL_CONSOLE = "115200 ttyAMA0"

{{ if qemuarch == "powerpc": }}
KERNEL_IMAGETYPE = "vmlinux"
SERIAL_CONSOLE = "115200 ttyS0"

{{ if qemuarch == "mips": }}
KERNEL_IMAGETYPE = "vmlinux"
KERNEL_ALT_IMAGETYPE = "vmlinux.bin"
SERIAL_CONSOLE = "115200 ttyS0"
MACHINE_EXTRA_RRECOMMENDS = " kernel-modules"
```
